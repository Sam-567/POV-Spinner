#include <Wire.h>
#include "RTClib.h"
#include <Adafruit_DotStar.h>
#include <SPI.h>   

unsigned long totalTime = 0;
double averageSpinTime;
unsigned long currentTime = 0;

int standard = 700;
int tolerance = 50;
RTC_DS1307 RTC;

#define TRUEPIXELS 27
#define NUMPIXELS 14
#define NUMTURNS 120.0
#define HALLSENSOR A0
#define CLOCKPIN 4
#define DISPLAYPIN 5

Adafruit_DotStar strip(TRUEPIXELS,DOTSTAR_BGR);

int Numbers[][5][3] = {
{ { 1, 1, 1},
  { 1, 0, 1},
  { 1, 0, 1},
  { 1, 0, 1},
  { 1, 1, 1}
},

{ { 0, 1, 0},
  { 1, 1, 0},
  { 0, 1, 0},
  { 0, 1, 0},
  { 1, 1, 1}
},

{ { 0, 1, 0},
  { 1, 0, 1},
  { 0, 0, 1},
  { 0, 1, 0},
  { 1, 1, 1}
},
{ { 1, 1, 1},
  { 0, 0, 1},
  { 1, 1, 1},
  { 0, 0, 1},
  { 1, 1, 1}
},
{ { 1, 0, 1},
  { 1, 0, 1},
  { 1, 1, 1},
  { 0, 0, 1},
  { 0, 0, 1}
},

{ { 1, 1, 1},
  { 1, 0, 0},
  { 1, 1, 1},
  { 0, 0, 1},
  { 1, 1, 1}
},

{ { 1, 1, 1},
  { 1, 0, 0},
  { 1, 1, 1},
  { 1, 0, 1},
  { 1, 1, 1}
},

{ { 1, 1, 1},
  { 0, 0, 1},
  { 0, 0, 1},
  { 0, 0, 1},
  { 0, 0, 1}
},

{ { 1, 1, 1},
  { 1, 0, 1},
  { 1, 1, 1},
  { 1, 0, 1},
  { 1, 1, 1}
},
  { { 1, 1, 1},
  { 1, 0, 1},
  { 1, 1, 1},
  { 0, 0, 1},
  { 1, 1, 1}
},

{ { 0, 0, 0},
  { 0, 1, 0},
  { 0, 0, 0},
  { 0, 1, 0},
  { 0, 0, 0}
}};

const PROGMEM byte image[][120][NUMPIXELS] = { 
 {
 { 39, 32, 24, 18, 31, 18, 0, 0, 0, 0, 0, 0, 0, 0 },
 { 38, 34, 25, 18, 17, 22, 28, 29, 17, 26, 58, 17, 0, 0 },
 { 40, 35, 24, 17, 14, 12, 13, 16, 20, 21, 96, 90, 0, 0 },
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 { 39, 32, 23, 17, 33, 1, 0, 0, 0, 0, 0, 0, 0, 0 } },
 {
 { 99, 90, 77, 59, 57, 20, 0, 0, 0, 0, 0, 0, 0, 0 },
 { 98, 92, 79, 58, 48, 46, 47, 37, 22, 34, 49, 15, 0, 0 },
 { 99, 92, 76, 58, 48, 47, 50, 51, 52, 56, 65, 65, 0, 0 },
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 { 99, 90, 76, 58, 58, 2, 0, 0, 0, 0, 0, 0, 0, 0 } },
 {
 { 226, 218, 201, 172, 145, 22, 0, 0, 0, 0, 0, 0, 0, 0 },
 { 225, 220, 203, 170, 147, 131, 107, 75, 39, 62, 53, 15, 0, 0 },
 { 226, 220, 200, 171, 152, 152, 157, 157, 154, 160, 70, 59, 0, 0 },
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 { 226, 217, 200, 171, 142, 2, 0, 0, 0, 0, 0, 0, 0, 0 } } };


void setup() {
  Wire.begin();
  RTC.begin();
  strip.begin();
  
  int i = 0;
  while (i < 28) {
    strip.setPixelColor(i, strip.Color(0,0,0));
    i++;
  }
  strip.show();
  delay(500);
  pinMode(HALLSENSOR, INPUT);
  pinMode(CLOCKPIN, INPUT);
  pinMode(DISPLAYPIN, INPUT);
  calculateAverageSpin();
}

void loop(){
  strip.clear();
  if( digitalRead(CLOCKPIN) == HIGH){
    digitalClock();
  } else if ( digitalRead(DISPLAYPIN) == HIGH){
    displayImage();
  }
}

void calculateAverageSpin(){
  int i = 0;
  unsigned long lastTime = micros();
  unsigned long currentTime;
  int x = 0;
  strip.setPixelColor(2,100,0,0);
  while( i < 40 ){
    while ( abs( analogRead(HALLSENSOR) - standard ) <= tolerance ) {
      delayMicroseconds(100);
    }
    if( micros() - lastTime < 250000 ){
      if( x > 15 ){
        currentTime = micros();
        totalTime += currentTime - lastTime;
        lastTime = currentTime;
        delay(25);
        i++;
      } else {
        x++;
      }
      strip.show();
    } else if {
      lastTime = micros();
    }
  }
  
  double average = totalTime / 40.0;

  averageSpinTime = average;
}

void digitalClock() {
  int spins = 0;
  while (spins < 20){
    DateTime now = RTC.now();
  
    int minute = now.minute();
    int hour = now.hour();
    if (hour > 12) { hour -= 12;}
    int LowMin = minute % 10;
    int HighMin = minute / 10;
    int LowHour = hour % 10;
    int HighHour = hour / 10;
  
  
    while ( abs( analogRead(HALLSENSOR) - standard ) <= tolerance ) {
      delay(0.5);
    }
    for (int i = 2; i >= 0; i--) {
      for ( int pin = 0; pin < 5; pin++ ) {
        strip.setPixelColor(pin, Numbers[LowMin][pin][i] * strip.Color(0,150,0));
      }
      strip.show();
      delay(2);
    }
  
    for ( int pin = 0; pin < 12; pin++ ) {
        strip.setPixelColor(pin, 0);
    }
    strip.show();
    delay(2);
  
    for (int i = 2; i >= 0; i--) {
      for ( int pin = 0; pin < 5; pin++ ) {
        strip.setPixelColor(pin,  strip.Color(0, Numbers[HighMin][pin][i] * 150,0));
      }
      strip.show();
      delay(2);
    }
  
    for (int i = 2; i >= 0; i--) {
      for ( int pin = 0; pin < 5; pin++ ) {
        strip.setPixelColor(pin, strip.Color(0, Numbers[10][pin][i] * 150,0));
      }
      strip.show();
      delay(2);
    }
  
    for (int i = 2; i >= 0; i--) {
      for ( int pin = 0; pin < 5; pin++ ) {
        strip.setPixelColor(pin, strip.Color(0, Numbers[LowHour][pin][i] * 150,0));
      }
      strip.show();
      delay(2);
    }
  
    if( HighHour != 0 ){
      for ( int pin = 0; pin < 12; pin++ ) {
        strip.setPixelColor(pin, 0 );
      }
      strip.show();
      delay (2);
  
      for (int i = 2; i >= 0; i--) {
        for ( int pin = 0; pin < 5; pin++ ) {
          strip.setPixelColor(pin, strip.Color(0, Numbers[HighHour][pin][i] * 150,0)); 
        }
        strip.show();
        delay(2);
      }
    }
    
    for ( int pin = 0; pin < 12; pin++ ) {
        strip.setPixelColor(pin, 0 );
    }
    strip.show();
    spins++;
  }
}

void displayImage() {

  int spins = 0;
  while (spins < 20) {
    while ( abs( analogRead(HALLSENSOR) - standard ) <= tolerance ) {
      delayMicroseconds(100);
    }
    
    currentTime = micros();
  
    for (int arg = 0; arg < NUMTURNS; arg++) {
      for (int mod = 0; mod < NUMPIXELS; mod++) {
        strip.setPixelColor( 13 - mod, pgm_read_byte(&(image[0][arg][mod])), pgm_read_byte(&(image[1][arg][mod])), pgm_read_byte(&(image[2][arg][mod])) );
      }
      while ( micros() - currentTime <  ((double) arg)*(averageSpinTime/(NUMTURNS))){
        delayMicroseconds(100);
      }
      strip.show();
    }
  spins++;
  }
}
