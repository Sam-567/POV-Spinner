
#include <Adafruit_NeoPixel.h>

unsigned long totalTime = 0;
double average;
unsigned long currentTime = 0;

int standard = 530;
int tolerance = 12;
int readPin = A0;

#define PIN 6
#define TRUEPIXELS 28
#define NUMPIXELS 14
#define NUMTURNS 60.0

const PROGMEM byte image[][60][NUMPIXELS] = { 
 {
 { 38, 33, 24, 18, 24, 20, 15, 15, 9, 13, 30, 9, 0, 0 },
 { 40, 35, 24, 17, 15, 15, 16, 18, 20, 27, 102, 104, 9, 0 },
 { 41, 35, 25, 17, 17, 24, 25, 27, 27, 69, 150, 133, 90, 0 },
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 { 38, 32, 23, 17, 26, 17, 17, 13, 4, 10, 29, 4, 0, 0 } },
 {
 { 98, 92, 78, 58, 53, 34, 25, 19, 11, 17, 25, 7, 0, 0 },
 { 99, 92, 77, 58, 50, 55, 57, 58, 59, 61, 63, 73, 6, 0 },
 { 99, 94, 80, 60, 58, 77, 79, 82, 82, 74, 76, 71, 59, 0 },
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 { 98, 91, 77, 58, 53, 27, 27, 16, 5, 14, 22, 4, 0, 0 } },
 {
 { 225, 219, 202, 171, 146, 80, 58, 39, 20, 32, 27, 8, 0, 0 },
 { 226, 219, 202, 171, 155, 166, 170, 170, 169, 163, 64, 68, 5, 0 },
 { 226, 221, 206, 174, 171, 201, 204, 207, 208, 146, 55, 53, 41, 0 },
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 { 224, 218, 201, 170, 144, 62, 54, 29, 8, 25, 22, 3, 0, 0 } } };


Adafruit_NeoPixel pixels = Adafruit_NeoPixel(TRUEPIXELS, PIN, NEO_GRB + NEO_KHZ800);


void setup() {
  pixels.begin();
  
  Serial.begin(9600);


  int i = 0;
  while (i < TRUEPIXELS) {
    pixels.setPixelColor(i, pixels.Color(120,120,0));
    i++;
  }
  pixels.show();

  pinMode(readPin, INPUT);
  delay(10000);

  i = 0;
  while (i < TRUEPIXELS) {
    pixels.setPixelColor(i, pixels.Color(0,0,0));
    i++;
  }
  pixels.show();
  
  average = averageSpin();
}


double averageSpin(){
  int i = 0;
  unsigned long lastTime = micros();
  unsigned long currentTime;
  while( i < 40 ){
    while ( abs( analogRead(readPin) - standard ) <= tolerance ) {
      delayMicroseconds(100);
    }
    currentTime = micros();
    totalTime += currentTime - lastTime;
    lastTime = currentTime;
    delay(25);
    i++;
  }

  double average = totalTime / 40.0;

  return average;
}


void loop() {

  
  while ( abs( analogRead(readPin) - standard ) <= tolerance ) {
    delayMicroseconds(100);
  }
  
  currentTime = micros();
  
  for (int arg = 0; arg < NUMTURNS; arg++) {
    
    for (int mod = 0; mod < NUMPIXELS; mod++) {
      pixels.setPixelColor( 13 - mod, pgm_read_byte(&(image[0][arg][mod])), pgm_read_byte(&(image[1][arg][mod])), pgm_read_byte(&(image[2][arg][mod])) );
    }
    while ( micros() - currentTime <  ((double) arg)*(average/(NUMTURNS))){
      delayMicroseconds(100);
    }
    pixels.show();
  }
  
  /*int i = 0;
  while (i < TRUEPIXELS) {
    pixels.setPixelColor(i, pixels.Color(0,0,0));
    i++;
  }
  pixels.show();*/
}
